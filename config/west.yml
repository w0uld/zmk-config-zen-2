## config/west.yml
```yaml
manifest:
  remotes:
    - name: zmkfirmware
      url-base: https://github.com/zmkfirmware
    - name: urob
      url-base: https://github.com/urob
  projects:
    - name: zmk
      remote: zmkfirmware
      revision: main   # set to desired version
      import: app/west.yml
    - name: zmk-helpers # https://github.com/urob/zmk-helpers
      remote: urob
      revision: main # set to same version as zmk
  self:
    path: config
```
